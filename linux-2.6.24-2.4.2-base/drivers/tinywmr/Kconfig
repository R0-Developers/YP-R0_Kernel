## linux-2.6.24-2.4.2-base/drivers/tinywmr/Kconfig
```kconfig
#
# Unified Flash Device configuration
#

menu "TinyBML Support for cramfs"

config RFS_TINYBML
        bool "Using Tiny Whimory for Cramfs"
        help
          cramfs using flash device
endmenu
```
